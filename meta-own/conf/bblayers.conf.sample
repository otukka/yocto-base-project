## meta-own/conf/bblayers.conf.sample
```bitbake
LCONF_VERSION = "7"

BBPATH = "${TOPDIR}"
BBFILES ?= ""

BBLAYERS ?= " \
    ##OEROOT##/meta \
    ##OEROOT##/meta-poky \
    ##OEROOT##/../meta-openembedded/meta-filesystems \
    ##OEROOT##/../meta-openembedded/meta-networking \
    ##OEROOT##/../meta-openembedded/meta-python \
    ##OEROOT##/../meta-openembedded/meta-initramfs \
    ##OEROOT##/../meta-openembedded/meta-multimedia \
    ##OEROOT##/../meta-openembedded/meta-oe \
    ##OEROOT##/../meta-xilinx/meta-xilinx-bsp \
    ##OEROOT##/../meta-xilinx/meta-xilinx-pynq \
    ##OEROOT##/../meta-xilinx/meta-xilinx-contrib \
    ##OEROOT##/../meta-xilinx-tools \
    ##OEROOT##/../meta-petalinux \
    ##OEROOT##/../meta-openamp \
    ##OEROOT##/../meta-virtualization \
    ##OEROOT##/../meta-qt5 \
    ##OEROOT##/../meta-own \
"

BBLAYERS_NON_REMOVABLE ?= " \
    ##OEROOT##/meta \
"
```

## meta-own/conf/layer.conf
```bitbake
# We have a conf and classes directory, add to BBPATH
BBPATH .= ":${LAYERDIR}"

# We have a packages directory, add to BBFILES
BBFILES += " \
		${LAYERDIR}/recipes-*/*/*.bb \
		${LAYERDIR}/recipes-*/*/*.bbappend"

BBFILE_COLLECTIONS += "own"
BBFILE_PRIORITY_own= "4"
BBFILE_PATTERN_own:= "^${LAYERDIR}/"

LAYERDEPENDS_own= "core"
LAYERDEPENDS_own+= "xilinx"
LAYERDEPENDS_own+= "xilinx-tools"

SIGGEN_EXCLUDERECIPES_ABISAFE += " \
	gcc-cross-xilinx \
	binutils-cross-xilinx \
	"
BB_DANGLINGAPPENDS_WARNONLY = "true"

LAYERSERIES_COMPAT_own= "thud"
```

## meta-own/conf/machine/custom-zcu111-zynqmp.conf
```bitbake
require conf/machine/zcu111-zynqmp.conf


SYSTEM_USER_DTSI = "custom/system-user.dtsi"


YAML_DT_BOARD_FLAGS = "{BOARD zcu111-reva}"
```

## meta-own/conf/machine/custom2-zcu111-zynqmp.conf
```bitbake
require conf/machine/zcu111-zynqmp.conf


SYSTEM_USER_DTSI = "custom/system-user.dtsi"
```
